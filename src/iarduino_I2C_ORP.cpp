#include "iarduino_I2C_ORP.h"																									//
																																//
//		Инициализация модуля:																									//	Возвращаемое значение: результат инициализации.
bool	iarduino_I2C_ORP::_begin			(void){																				//	Параметр: отсутствует
		//	Инициируем работу с шиной I2C:																						//
			selI2C->begin();																									//	Инициируем работу с выбранной шиной I2C в качестве мастера.
		//	Если адрес не указан, то ищим модуль на шине I2C:																	//
			if(valAddrTemp==0){																									//
				for(int i=1; i<127; i++){																						//	Проходим по всем адресам на шине I2C
					if( selI2C->checkAddress(i)											){	valAddr=i; delay(2);				//	Если на шине I2C есть устройство с адресом i, то используем этот адрес для проверки найденного модуля...
					if(_readBytes(REG_MODEL,4)											){										//	Читаем 4 байта начиная с регистра «REG_MODEL» в массив «data».
					if( data[0]     == DEF_MODEL_ORP									){										//	Если у модуля с адресом i в регистре «MODEL»   (data[0]) хранится значение DEF_MODEL_ORP, то ...
					if((data[2]>>1) == i                 || data[2] == 0xFF				){										//	Если у модуля с адресом i в регистре «ADDRESS» (data[2]) хранится значение i (адрес+младший бит) или 0xFF (адрес не задавался), то ...
					if( data[3]     == DEF_CHIP_ID_FLASH || data[3] == DEF_CHIP_ID_METRO){										//	Если у модуля с адресом i в регистре «CHIP_ID» (data[3]) хранится значение DEF_CHIP_ID_FLASH (идентификатор модулей Flash), или DEF_CHIP_ID_METRO (идентификатор модулей Metro), то ...
						valAddrTemp=i; i=128;																					//	Считаем что модуль обнаружен, сохраняем значение i как найденный адрес и выходим из цикла.
					}}}}}																										//
				}																												//
			}																													//
		//	Если модуль не найден, то возвращаем ошибку инициализации:															//
			if( valAddrTemp == 0														){	valAddr=0; return false;}			//
		//	Проверяем наличие модуля на шине I2C:																				//
			if( selI2C->checkAddress(valAddrTemp) == false								){	valAddr=0; return false;}			//	Если на шине I2C нет устройств с адресом valAddrTemp, то возвращаем ошибку инициализации
			valAddr=valAddrTemp;																								//	Сохраняем адрес модуля на шине I2C.
			delay(5);																											//
		//	Проверяем значения регистров модуля:																				//
			if(_readBytes(REG_MODEL,4)==false											){	valAddr=0; return false;}			//	Если не удалось прочитать 4 байта в массив «data» из модуля начиная с регистра «REG_MODEL», то возвращаем ошибку инициализации.
			if( data[0]     != DEF_MODEL_ORP											){	valAddr=0; return false;}			//	Если значение  регистра «MODEL»   (data[0]) не совпадает со значением DEF_MODEL_ORP, то возвращаем ошибку инициализации.
			if((data[2]>>1) != valAddrTemp       && data[2] !=0xFF						){	valAddr=0; return false;}			//	Если значение  регистра «ADDRESS» (data[2]) не совпадает с адресом модуля и не совпадает со значением 0xFF, то возвращаем ошибку инициализации.
			if( data[3]     != DEF_CHIP_ID_FLASH && data[3] != DEF_CHIP_ID_METRO		){	valAddr=0; return false;}			//	Если значение  регистра «CHIP_ID» (data[3]) не совпадает со значением DEF_CHIP_ID_FLASH и DEF_CHIP_ID_METRO, то возвращаем ошибку инициализации.
			valVers=data[1];																									//	Сохраняем байт регистра «VERSION» (data[1]) в переменую «valVers».
		//	Перезагружаем модуль устанавливая его регистры в значение по умолчанию:												//
			reset();																											//	Выполняем программную перезагрузку.
			delay(5);																											//
			return true;																										//	Возвращаем флаг успешной инициализаии.
}																																//
																																//
//		Перезагрузка модуля:																									//	Возвращаемое значение:	результат перезагрузки.
bool	iarduino_I2C_ORP::reset				(void){																				//	Параметр:				отсутствует.
			if(valAddr){																										//	Если модуль был инициализирован, то ...
			//	Устанавливаем бит перезагрузки:																					//
				if(_readBytes(REG_BITS_0,1)==false){return false;}																//	Читаем 1 байт регистра «BITS_0» в массив «data».
				data[0] |= 0b10000000;																							//	Устанавливаем бит «SET_RESET»
				if(_writeBytes(REG_BITS_0,1)==false){return false;}																//	Записываем 1 байт в регистр «BITS_0» из массива «data».
			//	Переинициируем шину в связи с программным отключением подтяжек шины I2C в модуле:						//
				delay(10); selI2C->begin();																				//	Ждём восстановление подтяжек линий SCL/SDA и переинициируем работу с шиной I2C.
			//	Ждём установки флага завершения перезагрузки:																	//
				do{ if(_readBytes(REG_FLAGS_0,1)==false){return false;} }														//	Читаем 1 байт регистра «REG_FLAGS_0» в массив «data».
				while( (data[0]&0b10000000) == 0);																				//	Повторяем чтение пока не установится флаг «FLG_RESET».
				return true;																									//
			}else{																												//	Иначе, если модуль не инициализирован, то ...
				return false;																									//	Возвращаем ошибку.
			}																													//
}																																//
																																//
//		Смена адреса модуля:																									//	Возвращаемое значение:	резульат смены адреса.
bool	iarduino_I2C_ORP::changeAddress		(uint8_t newAddr){																	//	Параметр:				newAddr - новый адрес модуля (0x07 < адрес < 0x7F).
			if(valAddr){																										//	Если модуль был инициализирован, то ...
			//	Проверяем новый адрес:																							//
				if(newAddr>0x7F){newAddr>>=1;}																					//	Корректируем адрес, если он указан с учётом бита RW.
				if(newAddr==0x00 || newAddr==0x7F){return false;}																//	Запрещаем устанавливать адрес 0x00 и 0x7F.
			//	Записываем новый адрес:																							//
				if(_readBytes(REG_BITS_0,1)==false){return false;}																//	Читаем 1 байт регистра «BITS_0» в массив «data».
				data[0] &= 0b11110111;																							//	Сбрасываем    бит «BLOCK_ADR».
				data[0] |= 0b00000010;																							//	Устанавливаем бит «SAVE_ADR_EN».
				if(_writeBytes(REG_BITS_0,1)==false){return false;}																//	Записываем 1 байт в регистр «BITS_0» из массива «data».
				data[0] = (newAddr<<1)|0x01;																					//	Готовим новый адрес к записи в модуль, установив бит «SAVE_FLASH».
				if(_writeBytes(REG_ADDRESS,1)==false){return false;}															//	Записываем 1 байт в регистр «ADDRESS» из массива «data».
				delay(200);																										//	Даём более чем достаточное время для применения модулем нового адреса.
			//	Проверяем наличие модуля с новым адресом на шине I2C:															//
				if(selI2C->checkAddress(newAddr)==false){return false;}															//	Если на шине I2C нет модуля с адресом newAddr, то возвращаем ошибку.
				valAddr     = newAddr;																							//	Сохраняем новый адрес как текущий.
				valAddrTemp = newAddr;																							//	Сохраняем новый адрес как указанный.
				return true;																									//	Возвращаем флаг успеха.
			}else{																												//	Иначе, если модуль не инициализирован, то ...
				return false;																									//	Возвращаем ошибку.
			}																													//
}																																//
																																//
//		Получение флага наличия подтяжки линий шины I2C:																		//	Возвращаемое значение:	флаг наличия подтяжки линий шины I2C.
bool	iarduino_I2C_ORP::getPullI2C		(void){																				//	Параметр:				отсутствует.
			if(valAddr){																										//	Если модуль был инициализирован, то ...
			//	Считываем первые два регистра: регистр флагов и регистр битов:													//
				if(_readBytes(REG_FLAGS_0,2)==false ){ return false; }															//	Читаем 2 байта начиная с регистра «REG_FLAGS_0» в массив «data».
			//	Проверяем поддерживает ли модуль управление подтяжкой линий шины I2C:											//
				if( (data[0] & 0b00000100) == false ){ return false; }															//	Если флаг «FLG_I2C_UP» регистра «REG_FLAGS_0» сброшен, значит модуль не поддерживает управление подтяжкой линий шины I2C.
			//	Проверяем установлена ли подтяжка линий шины I2C:																//
				if( (data[1] & 0b00000100) == false ){ return false; }															//	Если бит  «SET_I2C_UP» регистра «REG_BITS_0»  сброшен, значит подтяжка линий шины I2C не установлена.
				return true;																									//	Возвращаем флаг успеха.
			}else{																												//	Иначе, если модуль не инициализирован, то ...
				return false;																									//	Возвращаем ошибку.
			}																													//
}																																//
																																//
//		Установка подтяжки линий шины I2C:																						//	Возвращаемое значение:	результат установки подтяжки линий шины I2C.
bool	iarduino_I2C_ORP::setPullI2C		(bool f){																			//	Параметр:				флаг подтяжки линий шины I2C.
			if(valAddr){																										//	Если модуль был инициализирован, то ...
			//	Считываем первые два регистра: регистр флагов и регистр битов:													//
				if(_readBytes(REG_FLAGS_0,2)==false ){ return false; }															//	Читаем 2 байта начиная с регистра «REG_FLAGS_0» в массив «data».
			//	Проверяем поддерживает ли модуль управление подтяжкой линий шины I2C:											//
				if( (data[0] & 0b00000100) == false ){ return false; }															//	Если флаг «FLG_I2C_UP» регистра «REG_FLAGS_0» сброшен, значит модуль не поддерживает управление подтяжкой линий шины I2C.
			//	Устанавливаем или сбрасываем бит включения подтяжки линий шины I2C:												//
				if(f){ data[0] = (data[1] |  0b00000100); }																		//	Если флаг «f» установлен, то копируем значение из 1 в 0 элемент массива «data» установив бит «SET_I2C_UP».
				else { data[0] = (data[1] & ~0b00000100); }																		//	Если флаг «f» сброшен   , то копируем значение из 1 в 0 элемент массива «data» сбросив   бит «SET_I2C_UP».
			//	Сохраняем получившееся значение в регистр «REG_BITS_0»:															//
				if(_writeBytes(REG_BITS_0,1)==false ){ return false; }															//	Записываем 1 байт в регистр «REG_BITS_0» из массива «data».
				delay(50);																										//	Даём время для сохранения данных в энергонезависимую память модуля.
				return true;																									//	Возвращаем флаг успеха.
			}else{																												//	Иначе, если модуль не инициализирован, то ...
				return false;																									//	Возвращаем ошибку.
			}																													//
}																																//
																																//
//		Запуск калибровки модуля:																								//	Возвращаемое значение:	результат запуска калибровки.
bool	iarduino_I2C_ORP::setCalibration	(int16_t Eh){																		//	Параметр:				Eh - ОВП от 0 до ±1600мВ.
			if(valAddr){																										//	Если модуль был инициализирован, то ...
			//	Проверяем полученные данные:																					//
				if( Eh <-1600 ){ return false; }																				//	Параметр «Eh» определяет ОВП в диапазоне от 0 до ±1600мВ.
				if( Eh > 1600 ){ return false; }																				//	Параметр «Eh» определяет ОВП в диапазоне от 0 до ±1600мВ.
			//	Готовим данные для записи:																						//
				data[0] = (Eh   ) & 0x00FF;																						//	Устанавливаем младший байт значения «Eh» для регистра «REG_ORP_SOFTWARE_Eh».
				data[1] = (Eh>>8) & 0x00FF;																						//	Устанавливаем старший байт значения «Eh» для регистра «REG_ORP_SOFTWARE_Eh».
			//	Отправляем подготовленные данные в модуль:																		//
				if(_writeBytes(REG_ORP_SOFTWARE_Eh, 2)==false ){ return false; }												//	Записываем 2 байта из массива «data» в регистр «REG_ORP_SOFTWARE_Eh».
			//	Готовим данные для записи:																						//
				data[0] = ORP_BIT_CALC;																							//	Устанавливаем бит запуска калибровки.
				data[0] |= ORP_CODE_CALC_SAVE;																					//	Добавляем код разрешения записи калибровочных данных.
			//	Отправляем подготовленные данные в модуль:																		//
				if(_writeBytes(REG_ORP_CALIBRATION, 1)==false ){ return false; }												//	Записываем 1 байт из массива «data» в регистр «REG_ORP_CALIBRATION».
				return true;																									//	Возвращаем флаг успеха.
			}else{																												//	Иначе, если модуль не инициализирован, то ...
				return false;																									//	Возвращаем ошибку.
			}																													//
}																																//
																																//
//		Получение статуса калибровки модуля:																					//	Возвращаемое значение:	статус калибровки: 0 (выполняется), 1 (успех), -1 (провал).
int8_t	iarduino_I2C_ORP::getCalibration	(void){																				//	Параметр:				отсутствует.
			if(valAddr){																										//	Если модуль был инициализирован, то ...
			//	Читаем данные из модуля:																						//
				_readBytes(REG_ORP_CALIBRATION, 1);																				//	Читаем 1 байт из регистра «REG_ORP_CALIBRATION» в массив «data».
			//	Возвращаем результат:																							//
				return (data[0]&ORP_FLG_STATUS)?0:((data[0]&ORP_FLG_RESULT)?1:-1);												//	Возвращаем: 0 (выполняется), 1 (успех), или -1 (провал).
			}																													//	
			return -1;																											//	Возвращаем ошибку: Калибровка не пройдена.
}																																//
																																//
//		Получение ОВП жидкости требуемого для калибровки модуля с кнопки:														//	Возвращаемое значение:	ОВП калибровочной жидкости в мВ.
int16_t	iarduino_I2C_ORP::getKnownEh		(void){																				//	Параметр:				отсутствует.
			if(valAddr){																										//	Если модуль был инициализирован, то ...
			//	Читаем данные из модуля:																						//
				_readBytes(REG_ORP_HARDWARE_Eh, 2);																				//	Читаем 2 байта из регистров «REG_ORP_HARDWARE_Eh» в массив «data».
			//	Возвращаем результат:																							//
				return (int16_t)( ((int16_t)data[1]<<8) | data[0] );															//	Возвращаем ОВП от 0 до ±1600мв.
			}																													//	
			return 0;																											//	Возвращаем ошибку.
}																																//
																																//
//		Установка ОВП жидкости требуемого для калибровки модуля с кнопки:														//	Возвращаемое значение:	результат установки.
bool	iarduino_I2C_ORP::setKnownEh		(int16_t Eh){																		//	Параметр:				ОВП калибровочной жидкости в мВ.
			if(valAddr){																										//	Если модуль был инициализирован, то ...
			//	Проверяем полученные данные:																					//
				if( Eh <-1600 ){ return false; }																				//	Параметр «Eh» определяет ОВП в диапазоне от 0 до ±1600мВ.
				if( Eh > 1600 ){ return false; }																				//	Параметр «Eh» определяет ОВП в диапазоне от 0 до ±1600мВ.
			//	Разрешаем запись калибровочных данных:																			//	
				data[0] = ORP_CODE_CALC_SAVE;																					//	Копируем код разрешения записи калибровочных данных в массив «data».
				if(_writeBytes(REG_ORP_CALIBRATION, 1)==false ){ return false; }												//	Записываем 1 байт из массива «data» в регистр «REG_ORP_CALIBRATION».
			//	Готовим данные для записи:																						//
				data[0] =  Eh     & 0x00FF;																						//	Устанавливаем младший байт значения «Eh».
				data[1] = (Eh>>8) & 0x00FF;																						//	Устанавливаем старший байт значения «Eh».
			//	Отправляем подготовленные данные в модуль:																		//
				if(_writeBytes(REG_ORP_HARDWARE_Eh, 2)==false ){ return false; }												//	Записываем 2 байта из массива «data» в регистры «REG_ORP_HARDWARE_Eh».
				delay(50);																										//	Даём время для сохранения данных в энергонезависимую память модуля.
				return true;																									//	Возвращаем флаг успеха.
			}else{																												//	Иначе, если модуль не инициализирован, то ...
				return false;																									//	Возвращаем ошибку.
			}																													//
}																																//
																																//
//		Получение поправочного коэффициента:																					//	Возвращаемое значение:	поправочный коэффициент от 0,0001 до 6,5535.
float	iarduino_I2C_ORP::getK			(void){																					//	Параметр:				отсутствует.
			if(valAddr){																										//	Если модуль был инициализирован, то ...
			//	Читаем данные из модуля:																						//
				_readBytes(REG_ORP_K, 2);																						//	Читаем 2 байта из регистра «REG_ORP_K» в массив «data».
			//	Возвращаем результат:																							//
				return (float)( ((uint16_t)data[1]<<8) | data[0] )/10000.0f;													//	Возвращаем результат, преобразовав значение из десятитысячных долей.
			}																													//	
			return 0;																											//	Возвращаем ошибку.
}																																//
																																//
//		Установка коэффициента усиления усилителя:																				//	Возвращаемое значение:	результат установки.
bool	iarduino_I2C_ORP::setK			(float K){																				//	Параметр:				поправочный коэффициент от 0,0001 до 6,5535.
			if(valAddr){																										//	Если модуль был инициализирован, то ...
			//	Проверяем полученные данные:																					//
				if( (K<0.0001f) || (K>6.5535f) ){ return false; }																//	Параметр «K» определяет поправочный коэффициент и может принимать значения от 0,0001 до 6,5535.
			//	Разрешаем запись калибровочных данных:																			//	
				data[0] = ORP_CODE_CALC_SAVE;																					//	Копируем код разрешения записи калибровочных данных в массив «data».
				if(_writeBytes(REG_ORP_CALIBRATION, 1)==false ){ return false; }												//	Записываем 1 байт из массива «data» в регистр «REG_ORP_CALIBRATION».
			//	Готовим данные для записи:																						//
				data[0] =  (uint16_t)(K*10000.0f)     & 0x00FF;																	//	Устанавливаем младший байт значения «K».
				data[1] = ((uint16_t)(K*10000.0f)>>8) & 0x00FF;																	//	Устанавливаем старший байт значения «K».
			//	Отправляем подготовленные данные в модуль:																		//
				if(_writeBytes(REG_ORP_K, 2)==false ){ return false; }															//	Записываем 2 байта из массива «data» в регистр «REG_ORP_K».
				delay(50);																										//	Даём время для сохранения данных в энергонезависимую память модуля.
				return true;																									//	Возвращаем флаг успеха.
			}else{																												//	Иначе, если модуль не инициализирован, то ...
				return false;																									//	Возвращаем ошибку.
			}																													//
}																																//
																																//
//		Получение напряжения на входе датчика:																					//	Возвращаемое значение:	напряжение на входе датчика от 0 до 6,5535 В.
float	iarduino_I2C_ORP::getVin		(void){																					//
			if(valAddr){																										//	Если модуль был инициализирован, то ...
			//	Читаем данные из модуля:																						//
				_readBytes(REG_ORP_Vin, 2);																						//	Читаем 2 байта из регистра «REG_ORP_Vin» в массив «data».
			//	Возвращаем результат:																							//
				return (float)( ((uint16_t)data[1]<<8) | data[0] )/10000.0f;													//	Возвращаем результат, преобразовав значение из десятитысячных долей В.
			}																													//	
			return 0;																											//	Возвращаем ошибку.
}																																//
																																//
//		Получение напряжения на выходе усилителя:																				//	Возвращаемое значение:	напряжение на выходе модуля от 0 до 6,5535 В.
float	iarduino_I2C_ORP::getVout		(void){																					//	Параметр:				отсутствует.
			if(valAddr){																										//	Если модуль был инициализирован, то ...
			//	Читаем данные из модуля:																						//
				_readBytes(REG_ORP_Vout, 2);																					//	Читаем 2 байта из регистра «REG_ORP_Vout» в массив «data».
			//	Возвращаем результат:																							//
				return (float)( ((uint16_t)data[1]<<8) | data[0] )/10000.0f;													//	Возвращаем результат, преобразовав значение из десятитысячных долей В.
			}																													//	
			return 0;																											//	Возвращаем ошибку.
}																																//
																																//
//		Получение ОВП жидкости:																									//	Возвращаемое значение:	ОВП жидкости от 0 до ±1600 мВ.
int16_t	iarduino_I2C_ORP::getEh			(void){																					//	Параметр:				отсутствует.
			if(valAddr){																										//	Если модуль был инициализирован, то ...
			//	Читаем данные из модуля:																						//
				_readBytes(REG_ORP_Eh, 2);																						//	Читаем 2 байта из регистров «REG_ORP_Eh» в массив «data».
			//	Возвращаем результат:																							//
				return (int16_t)( ((int16_t)data[1]<<8) | data[0] );															//	Возвращаем ОВП от 0 до ±1600мв.
			}																													//	
			return 0;																											//	Возвращаем ошибку.
}																																//
																																//
//		Чтение данных из регистров в массив data:																				//	Возвращаемое значение:	результат чтения (true/false).
bool	iarduino_I2C_ORP::_readBytes		(uint8_t reg, uint8_t sum){															//	Параметры:				reg - номер первого регистра, sum - количество читаемых байт.
			bool	result=false;																								//	Определяем флаг       для хранения результата чтения.
			uint8_t	sumtry=10;																									//	Определяем переменную для подсчёта количества оставшихся попыток чтения.
			do{	result = selI2C->readBytes(valAddr, reg, data, sum);															//	Считываем из модуля valAddr, начиная с регистра reg, в массив data, sum байт.
				sumtry--;	if(!result){delay(1);}																				//	Уменьшаем количество попыток чтения и устанавливаем задержку при неудаче.
			}	while		(!result && sumtry>0);																				//	Повторяем чтение если оно завершилось неудачей, но не более sumtry попыток.
			delayMicroseconds(500);																								//	Между пакетами необходимо выдерживать паузу.
			return result;																										//	Возвращаем результат чтения (true/false).
}																																//
																																//
//		Запись данных в регистры из массива data:																				//	Возвращаемое значение:	результат записи (true/false).
bool	iarduino_I2C_ORP::_writeBytes	(uint8_t reg, uint8_t sum, uint8_t num){											//	Параметры:				reg - номер первого регистра, sum - количество записываемых байт, num - номер первого элемента массива data.
			bool	result=false;																								//	Определяем флаг       для хранения результата записи.
			uint8_t	sumtry=10;																									//	Определяем переменную для подсчёта количества оставшихся попыток записи.
			do{	result = selI2C->writeBytes(valAddr, reg, &data[num], sum);														//	Записываем в модуль valAddr начиная с регистра reg, sum байи из массива data начиная с элемента num.
				sumtry--;	if(!result){delay(1);}																				//	Уменьшаем количество попыток записи и устанавливаем задержку при неудаче.
			}	while		(!result && sumtry>0);																				//	Повторяем запись если она завершилась неудачей, но не более sumtry попыток.
			delay(10);																											//	Ждём применения модулем записанных данных.
			return result;																										//	Возвращаем результат записи (true/false).
}																																//
																																//